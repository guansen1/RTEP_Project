#include "display.hpp"
#include <fcntl.h>
#include <unistd.h>
#include <sys/ioctl.h>
#include <linux/i2c-dev.h>
#include <cstring>
#include <iostream>

// 定义 I2C 设备文件和 OLED 地址
#define I2C_DEVICE "/dev/i2c-1"
#define SSD1306_ADDR 0x3C

// 5x7 字体数据（ASCII 32 至 127，公共领域字体）
const uint8_t SSD1306Display::font5x7[96][5] = {
    {0x00,0x00,0x00,0x00,0x00}, // 32 空格
    {0x00,0x00,0x5F,0x00,0x00}, // 33 !
    {0x00,0x07,0x00,0x07,0x00}, // 34 "
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    {0x00,0x00,0x00,0x00,0x00}  // 127 (DEL)
};

// 构造函数：初始化缓冲区，打开 I2C 设备，执行初始化序列
SSD1306Display::SSD1306Display() : i2c_fd(-1) {
    memset(buffer, 0, sizeof(buffer));
    i2c_fd = open(I2C_DEVICE, O_RDWR);
    if (i2c_fd < 0) {
        perror("打开 I2C 设备失败");
    }
    if (ioctl(i2c_fd, I2C_SLAVE, SSD1306_ADDR) < 0) {
        perror("获取 SSD1306 总线控制权失败");
    }
    if (!initialize()) {
        std::cerr << "SSD1306 初始化失败！" << std::endl;
    }
}

// 析构函数：关闭 I2C 设备
SSD1306Display::~SSD1306Display() {
    if (i2c_fd >= 0) {
        close(i2c_fd);
    }
}

// 发送一个命令字节（控制字节为 0x00）
bool SSD1306Display::writeCommand(uint8_t cmd) {
    uint8_t data[2];
    data[0] = 0x00; // 命令控制字节
    data[1] = cmd;
    if (write(i2c_fd, data, 2) != 2) {
        perror("写入命令失败");
        return false;
    }
    return true;
}

// 发送数据块（数据控制字节为 0x40）
bool SSD1306Display::writeData(const uint8_t *data, size_t length) {
    uint8_t *buf = new uint8_t[length + 1];
    buf[0] = 0x40; // 数据控制字节
    memcpy(buf + 1, data, length);
    if (write(i2c_fd, buf, length + 1) != (ssize_t)(length + 1)) {
        perror("写入数据失败");
        delete[] buf;
        return false;
    }
    delete[] buf;
    return true;
}

// 发送标准初始化命令序列
bool SSD1306Display::initialize() {
    std::lock_guard<std::mutex> lock(displayMutex);
    if (!writeCommand(0xAE)) return false; // 关闭显示
    if (!writeCommand(0xD5)) return false; // 设置时钟分频
    if (!writeCommand(0x80)) return false; // 设置建议比例
    if (!writeCommand(0xA8)) return false; // 设置多路复用率
    if (!writeCommand(0x3F)) return false; // 63 (0~63)
    if (!writeCommand(0xD3)) return false; // 设置显示偏移
    if (!writeCommand(0x00)) return false; // 无偏移
    if (!writeCommand(0x40)) return false; // 设置起始行地址
    if (!writeCommand(0x8D)) return false; // Charge Pump 设置
    if (!writeCommand(0x14)) return false; // 启用 Charge Pump
    if (!writeCommand(0x20)) return false; // 内存地址模式
    if (!writeCommand(0x00)) return false; // 水平地址模式
    if (!writeCommand(0xA1)) return false; // 设置段重映射
    if (!writeCommand(0xC8)) return false; // 设置 COM 输出扫描方向
    if (!writeCommand(0xDA)) return false; // 设置 COM 引脚配置
    if (!writeCommand(0x12)) return false;
    if (!writeCommand(0x81)) return false; // 设置对比度
    if (!writeCommand(0xCF)) return false;
    if (!writeCommand(0xD9)) return false; // 设置预充电周期
    if (!writeCommand(0xF1)) return false;
    if (!writeCommand(0xDB)) return false; // 设置 VCOMH 去除电平
    if (!writeCommand(0x40)) return false;
    if (!writeCommand(0xA4)) return false; // 恢复显示 RAM 内容
    if (!writeCommand(0xA6)) return false; // 正常显示
    if (!writeCommand(0xAF)) return false; // 开启显示
    return true;
}

// 将缓冲区写入屏幕之前，需要设置列地址和页地址
bool SSD1306Display::updateBuffer() {
    std::lock_guard<std::mutex> lock(displayMutex);
    if (!writeCommand(0x21)) return false; // 设置列地址命令
    if (!writeCommand(0x00)) return false; // 起始列 0
    if (!writeCommand(0x7F)) return false; // 结束列 127
    if (!writeCommand(0x22)) return false; // 设置页地址命令
    if (!writeCommand(0x00)) return false; // 起始页 0
    if (!writeCommand(0x07)) return false; // 结束页 7
    if (!writeData(buffer, sizeof(buffer))) return false;
    return true;
}

// 清空缓冲区并刷新显示
bool SSD1306Display::clear() {
    std::lock_guard<std::mutex> lock(displayMutex);
    memset(buffer, 0x00, sizeof(buffer));
    return updateBuffer();
}

// 根据传入文本，将字符绘制到对应页和列，然后刷新显示
// 每个字符占 6 列（5 列字形 + 1 列间隔）
bool SSD1306Display::updateText(const std::string &text, int page, int col) {
    std::lock_guard<std::mutex> lock(displayMutex);
    if (page < 0 || page >= PAGES || col < 0 || col >= WIDTH) return false;
    int pos = page * WIDTH + col;
    for (char c : text) {
        if (c < 32 || c > 127) continue; // 忽略不支持字符
        const uint8_t* glyph = font5x7[c - 32];
        for (int i = 0; i < 5; i++) {
            if (pos < (int)sizeof(buffer))
                buffer[pos++] = glyph[i];
        }
        // 加入一列空白
        if (pos < (int)sizeof(buffer))
            buffer[pos++] = 0x00;
        // 超出一行则停止
        if ((pos % WIDTH) >= WIDTH) break;
    }
    return updateBuffer();
}
